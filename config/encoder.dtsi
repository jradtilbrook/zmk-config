/*
 * Override the encoder settings for Panasonic EVQWGD001
 */
&left_encoder {
    steps = <15>;
};

&right_encoder {
    steps = <15>;
};

&sensors {
    triggers-per-rotation = <15>;
};
// vi: ft=dts textwidth=0 noautoindent
